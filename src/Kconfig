## src/Kconfig
```kconfig
# Main Kconfig settings

mainmenu "Klipper Firmware Configuration"

config LOW_LEVEL_OPTIONS
    bool "Enable extra low-level configuration options"
    default n
    help
        Enable low-level configuration options that (if modified) may
        result in a build that does not function correctly.

choice
    prompt "Micro-controller Architecture"
    config MACH_AVR
        bool "Atmega AVR"
    config MACH_ATSAM
        bool "SAM3/SAM4 (Due and Duet)"
    config MACH_ATSAMD
        bool "SAMD21/SAMD51"
    config MACH_LPC176X
        bool "LPC176x (Smoothieboard)"
    config MACH_STM32
        bool "STMicroelectronics STM32"
    config MACH_RP2040
        bool "Raspberry Pi RP2040"
    config MACH_PRU
        bool "Beaglebone PRU"
    config MACH_LINUX
        bool "Linux process"
    config MACH_SIMU
        bool "Host simulator"
endchoice

source "src/avr/Kconfig"
source "src/atsam/Kconfig"
source "src/atsamd/Kconfig"
source "src/lpc176x/Kconfig"
source "src/stm32/Kconfig"
source "src/rp2040/Kconfig"
source "src/pru/Kconfig"
source "src/linux/Kconfig"
source "src/simulator/Kconfig"

# Generic configuration options for serial ports
config SERIAL_BAUD
    depends on SERIAL
    int "Baud rate for serial port" if LOW_LEVEL_OPTIONS
    default 250000
    help
        Specify the baud rate of the serial port. This should be set
        to 250000. Read the FAQ before changing this value.

# Generic configuration options for USB
config USB_VENDOR_ID
    default 0x1d50
config USB_DEVICE_ID
    default 0x614e
config USB_SERIAL_NUMBER_CHIPID
    depends on HAVE_CHIPID
    default y
config USB_SERIAL_NUMBER
    default "12345"

menu "USB ids"
    depends on USBSERIAL && LOW_LEVEL_OPTIONS
config USB_VENDOR_ID
    hex "USB vendor ID"
config USB_DEVICE_ID
    hex "USB device ID"
config USB_SERIAL_NUMBER_CHIPID
    bool "USB serial number from CHIPID" if HAVE_CHIPID
config USB_SERIAL_NUMBER
    string "USB serial number" if !USB_SERIAL_NUMBER_CHIPID
endmenu

# Step timing customization
config CUSTOM_STEP_DELAY
    bool "Specify a custom step pulse duration"
    depends on LOW_LEVEL_OPTIONS
config STEP_DELAY
    int
    default 2
config STEP_DELAY
    int "Step pulse duration (in microseconds)"
    depends on CUSTOM_STEP_DELAY
    help
        Specify the duration of the stepper step pulse time. This
        setting applies to all stepper drivers controlled by the
        micro-controller. If this value is set to zero (or less) then
        the code will "step" and "unstep" in the same C function.

        A setting of zero (or less) on 8-bit AVR micro-controllers
        results in a minimum step pulse time a little over 2us.

        A setting of zero on ARM micro-controllers typically results
        in a minimum step pulse time of 20 cpu cycles.

        The default for AVR is -1, for all other micro-controllers it
        is 2us.

config INITIAL_PINS
    string "GPIO pins to set at micro-controller startup"
    depends on LOW_LEVEL_OPTIONS
    help
        One may specify a comma separated list of gpio pins to set
        during the micro-controller startup sequence. By default the
        pins will be set to output high - preface a pin with a '!'
        character to set that pin to output low.

# The HAVE_x options allow boards to disable support for some commands
# if the hardware does not support the feature.
config HAVE_GPIO
    bool
    default n
config HAVE_GPIO_ADC
    bool
    default n
config HAVE_GPIO_SPI
    bool
    default n
config HAVE_GPIO_I2C
    bool
    default n
config HAVE_GPIO_HARD_PWM
    bool
    default n
config HAVE_GPIO_BITBANGING
    bool
    default n
config HAVE_STRICT_TIMING
    bool
    default n
config HAVE_CHIPID
    bool
    default n

config INLINE_STEPPER_HACK
    # Enables gcc to inline stepper_event() into the main timer irq handler
    bool
    depends on HAVE_GPIO
    default y
```

## src/atsamd/Kconfig
```kconfig
# Kconfig settings for Atmel SAMD processors

if MACH_ATSAMD

config ATSAMD_SELECT
    bool
    default y
    select HAVE_GPIO
    select HAVE_GPIO_ADC
    select HAVE_GPIO_I2C
    select HAVE_GPIO_SPI
    select HAVE_GPIO_HARD_PWM if MACH_SAMD21
    select HAVE_GPIO_BITBANGING
    select HAVE_STRICT_TIMING
    select HAVE_CHIPID

config HAVE_SERCOM
    depends on HAVE_GPIO_I2C || HAVE_GPIO_SPI
    bool
    default y

config BOARD_DIRECTORY
    string
    default "atsamd"

choice
    prompt "Processor model"
    config MACH_SAMD21G18
        bool "SAMD21G18 (Arduino Zero)"
        select MACH_SAMD21
    config MACH_SAMD21E18
        bool "SAMD21E18 (Adafruit Trinket M0)"
        select MACH_SAMD21
    config MACH_SAMD21E15
        bool "SAMD21E15"
        select MACH_SAMD21
    config MACH_SAMD51G19
        bool "SAMD51G19 (Adafruit ItsyBitsy M4)"
        select MACH_SAMD51
    config MACH_SAMD51J19
        bool "SAMD51J19 (Adafruit Metro M4)"
        select MACH_SAMD51
    config MACH_SAMD51N19
        bool "SAMD51N19"
        select MACH_SAMD51
    config MACH_SAMD51P20
        bool "SAMD51P20 (Adafruit Grand Central)"
        select MACH_SAMD51
endchoice

config MACH_SAMD21
    bool
config MACH_SAMD51
    bool

config MCU
    string
    default "samd21g18a" if MACH_SAMD21G18
    default "samd21e18a" if MACH_SAMD21E18
    default "samd21e15a" if MACH_SAMD21E15
    default "samd51g19a" if MACH_SAMD51G19
    default "samd51j19a" if MACH_SAMD51J19
    default "samd51n19a" if MACH_SAMD51N19
    default "samd51p20a" if MACH_SAMD51P20

config FLASH_SIZE
    hex
    default 0x8000 if MACH_SAMD21E15
    default 0x40000 if MACH_SAMD21G18 || MACH_SAMD21E18
    default 0x80000 if MACH_SAMD51G19 || MACH_SAMD51J19 || MACH_SAMD51N19
    default 0x100000 if MACH_SAMD51P20

config RAM_START
    hex
    default 0x20000000

config RAM_SIZE
    hex
    default 0x1000 if MACH_SAMD21E15
    default 0x8000 if MACH_SAMD21G18 || MACH_SAMD21E18
    default 0x30000 if MACH_SAMD51G19 || MACH_SAMD51J19 || MACH_SAMD51N19
    default 0x40000 if MACH_SAMD51P20

config STACK_SIZE
    int
    default 512

choice
    prompt "Clock Reference"
    config CLOCK_REF_X32K
        bool "32.768Khz crystal"
    config CLOCK_REF_X25M
        bool "25Mhz crystal" if MACH_SAMD51
    config CLOCK_REF_INTERNAL
        bool "Internal clock"
endchoice

choice
    depends on MACH_SAMD51 && LOW_LEVEL_OPTIONS
    prompt "Processor speed"
    config SAMD51_FREQ_120
        bool "120 MHz (standard)"
    config SAMD51_FREQ_150
        bool "150 MHz (overclock)"
    config SAMD51_FREQ_180
        bool "180 MHz (overclock)"
    config SAMD51_FREQ_200
        bool "200 MHz (overclock)"
endchoice

config CLOCK_FREQ
    int
    default 48000000 if MACH_SAMD21
    default 150000000 if SAMD51_FREQ_150
    default 180000000 if SAMD51_FREQ_180
    default 200000000 if SAMD51_FREQ_200
    default 120000000 if MACH_SAMD51

choice
    prompt "Bootloader offset"
    config FLASH_START_2000
        depends on MACH_SAMD21
        bool "8KiB bootloader (Arduino Zero)"
    config FLASH_START_4000
        bool "16KiB bootloader (Arduino M0)"
    config FLASH_START_0000
        bool "No bootloader"
endchoice

config FLASH_START
    hex
    default 0x4000 if FLASH_START_4000
    default 0x2000 if FLASH_START_2000
    default 0x0000

config ARDUINO_STYLE_BOOTLOADER_TRIGGERING
    bool "Arduino style bootloader triggering"
    default y
    help
        Delay reset execution & erase application to force entering boot loader mode.
        This to accomodate bootloaders that has different double tap magic.

config USBSERIAL
    bool
config SERIAL
    bool
choice
    prompt "Communication interface"
    config ATSAMD_USB
        bool "USB"
        select USBSERIAL
    config ATSAMD_SERIAL
        bool "Serial"
        select SERIAL
endchoice

endif
```

## src/rp2040/Kconfig
```kconfig
# Kconfig settings for STM32 processors

if MACH_RP2040

config RP2040_SELECT
    bool
    default y
    select HAVE_GPIO
    select HAVE_GPIO_ADC
    select HAVE_GPIO_BITBANGING
    select HAVE_STRICT_TIMING
    select HAVE_CHIPID

config BOARD_DIRECTORY
    string
    default "rp2040"

config MCU
    string
    default "rp2040"

config CLOCK_FREQ
    int
    default 12000000

config FLASH_SIZE
    hex
    default 0x200000

config RAM_START
    hex
    default 0x20000000

config RAM_SIZE
    hex
    default 0x42000

config STACK_SIZE
    int
    default 512

config FLASH_START
    hex
    default 0x10000000

######################################################################
# Communication inteface
######################################################################

config USBSERIAL
    bool
config SERIAL
    bool
choice
    prompt "Communication interface"
    config RP2040_USB
        bool "USB"
        select USBSERIAL
    config RP2040_SERIAL_UART0
        bool "Serial (on UART0 GPIO1/GPIO0)"
        select SERIAL
endchoice

endif
```
